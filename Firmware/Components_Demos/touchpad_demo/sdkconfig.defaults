## Firmware/Components_Demos/touchpad_demo/sdkconfig.defaults
```kconfig
# CaPilot Touchpad Demo - 默认配置
# 立创实战派 ESP32-S3 开发板
# USB HID 鼠标版本

CONFIG_IDF_TARGET="esp32s3"

# Flash & 分区
CONFIG_ESPTOOLPY_FLASHSIZE_16MB=y
CONFIG_PARTITION_TABLE_CUSTOM=y
CONFIG_PARTITION_TABLE_CUSTOM_FILENAME="partitions.csv"

# PSRAM (Octal SPIRAM 80MHz)
CONFIG_SPIRAM=y
CONFIG_SPIRAM_MODE_OCT=y
CONFIG_SPIRAM_SPEED_80M=y
CONFIG_SPIRAM_MALLOC_ALWAYSINTERNAL=2048
CONFIG_SPIRAM_TRY_ALLOCATE_WIFI_LWIP=y

# CPU 240MHz
CONFIG_ESP_DEFAULT_CPU_FREQ_MHZ_240=y

# Cache
CONFIG_ESP32S3_INSTRUCTION_CACHE_32KB=y
CONFIG_ESP32S3_DATA_CACHE_64KB=y
CONFIG_ESP32S3_DATA_CACHE_LINE_64B=y

# LVGL 配色与字体
CONFIG_LV_COLOR_16_SWAP=y
CONFIG_LV_MEM_CUSTOM=y
CONFIG_LV_FONT_MONTSERRAT_20=y
CONFIG_LV_FONT_MONTSERRAT_24=y

# ===== TinyUSB HID 配置 =====
CONFIG_TINYUSB_HID_COUNT=1
```

## Firmware/Components_Demos/usb_headset_demo/sdkconfig.defaults
```kconfig
CONFIG_IDF_TARGET="esp32s3"
CONFIG_ESPTOOLPY_FLASHSIZE_16MB=y
CONFIG_PARTITION_TABLE_CUSTOM=y
CONFIG_PARTITION_TABLE_CUSTOM_FILENAME="partitions.csv"

# Audio buffers and the board's ESP32-S3-WROOM-1-N16R8 memory configuration.
CONFIG_SPIRAM=y
CONFIG_SPIRAM_MODE_OCT=y
CONFIG_SPIRAM_SPEED_80M=y
CONFIG_SPIRAM_USE_MALLOC=y

# This demo has no display, touch or camera functionality.
CONFIG_CAPILOT_BSP_TOUCH_ENABLE=n
CONFIG_CAPILOT_BSP_LVGL_ENABLE=n

# One HID keyboard interface is combined with the UAC2 headset.
CONFIG_TINYUSB_HID_COUNT=1
CONFIG_TINYUSB_DEBUG_LEVEL=0
CONFIG_FREERTOS_HZ=1000
CONFIG_LOG_DEFAULT_LEVEL_INFO=y
```

## Firmware/components/capilot_bsp/Kconfig
```kconfig
# capilot_bsp Kconfig
menu "CaPilot BSP Configuration"

    config CAPILOT_BSP_TOUCH_ENABLE
        bool "Enable touch screen (FT6336)"
        default y
        help
            Enable capacitive touch screen driver (FT6336 via I2C).
            Disable to save memory when touch is not needed.

    config CAPILOT_BSP_LVGL_ENABLE
        bool "Enable LVGL graphics library"
        default y
        help
            Enable LVGL (LittlevGL) with LCD + touch integration.
            Requires CAPILOT_BSP_TOUCH_ENABLE.

    config CAPILOT_BSP_LCD_SPI_FREQ
        int "LCD SPI clock frequency (Hz)"
        default 80000000
        range 1000000 80000000
        help
            SPI clock for LCD ST7789. Max 80MHz on ESP32-S3.

    config CAPILOT_BSP_LCD_BACKLIGHT_PWM_FREQ
        int "Backlight PWM frequency (Hz)"
        default 5000
        range 1000 100000
        help
            PWM frequency for LCD backlight control.

endmenu
```

## Firmware/demos/imu_demo/sdkconfig.defaults
```kconfig
# imu_demo sdkconfig defaults
# Minimal: I2C + IMU only, no LCD/Touch/LVGL

CONFIG_IDF_TARGET="esp32s3"

# Disable BSP optional features
CONFIG_CAPILOT_BSP_TOUCH_ENABLE=n
CONFIG_CAPILOT_BSP_LVGL_ENABLE=n

# Flash
CONFIG_ESPTOOLPY_FLASHSIZE_16MB=y
CONFIG_PARTITION_TABLE_CUSTOM=y
CONFIG_PARTITION_TABLE_CUSTOM_FILENAME="partitions.csv"

# PSRAM (Octal SPIRAM 80MHz)
CONFIG_SPIRAM=y
CONFIG_SPIRAM_MODE_OCT=y
CONFIG_SPIRAM_SPEED_80M=y

# CPU 240MHz
CONFIG_ESP_DEFAULT_CPU_FREQ_MHZ_240=y

# Cache
CONFIG_ESP32S3_INSTRUCTION_CACHE_32KB=y
CONFIG_ESP32S3_DATA_CACHE_64KB=y
CONFIG_ESP32S3_DATA_CACHE_LINE_64B=y

# FreeRTOS
CONFIG_FREERTOS_HZ=1000

# Logging
CONFIG_LOG_DEFAULT_LEVEL_INFO=y
```

## Skill/Esp-Component-Skill/templates/sdkconfig.defaults
```kconfig
# 立创实战派 ESP32-S3 默认配置
CONFIG_IDF_TARGET="esp32s3"
CONFIG_ESPTOOLPY_FLASHSIZE_16MB=y
CONFIG_PARTITION_TABLE_CUSTOM=y
CONFIG_PARTITION_TABLE_CUSTOM_FILENAME="partitions.csv"

# PSRAM
CONFIG_SPIRAM=y
CONFIG_SPIRAM_MODE_OCT=y
CONFIG_SPIRAM_SPEED_80M=y
CONFIG_SPIRAM_MALLOC_ALWAYSINTERNAL=2048

# CPU 240MHz + Cache
CONFIG_ESP_DEFAULT_CPU_FREQ_MHZ_240=y
CONFIG_ESP32S3_INSTRUCTION_CACHE_32KB=y
CONFIG_ESP32S3_DATA_CACHE_64KB=y
CONFIG_ESP32S3_DATA_CACHE_LINE_64B=y

# LVGL
CONFIG_LV_COLOR_16_SWAP=y
CONFIG_LV_MEM_CUSTOM=y
CONFIG_LV_FONT_MONTSERRAT_20=y

# 按需启用（取消注释）：
# BLE HID:
#   CONFIG_BT_ENABLED=y
#   CONFIG_BT_BLE_42_FEATURES_SUPPORTED=y
# USB HID:
#   CONFIG_TINYUSB_HID_COUNT=1
```
